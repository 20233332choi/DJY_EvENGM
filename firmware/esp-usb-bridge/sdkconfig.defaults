## firmware/esp-usb-bridge/sdkconfig.defaults
```kconfig
CONFIG_ESP_TASK_WDT_CHECK_IDLE_TASK_CPU0=n
CONFIG_SERIAL_FLASHER_MD5_ENABLED=y
CONFIG_ESPTOOLPY_FLASHSIZE_16MB=y
CONFIG_DEBUG_PROBE_IFACE_SWD=y
CONFIG_DEBUG_PROBE_IFACE_NAME="CMSIS-DAP"
CONFIG_DEBUG_PROBE_GPIO_TCK=10
CONFIG_DEBUG_PROBE_GPIO_TMS=8
CONFIG_BRIDGE_PRODUCT_NAME="DJY Energy Meter SWD Bridge"
```
